## config/west.yml
```yaml
manifest:
  remotes:
    - name: zmkfirmware
      url-base: https://github.com/zmk
    - name: y3sen
      url-base: https://github.com/y3sen/zmk-pete.git
  projects:
    - name: zmk
      remote: y3sen
      revision: display/bongo-cat-widget
      import: app/west.yml
  self:
    path: config
```
